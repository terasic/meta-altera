## conf/machine/arria10.conf
```bitbake
#@TYPE: Machine
#@NAME: arria5
#@DESCRIPTION: Machine configuration for the Arria 10 SoC" 

require conf/machine/include/socfpga.inc

UBOOT_MACHINE = "socfpga_arria10_defconfig"

KMACHINE = "arria10"

KERNEL_DEVICETREE ?= "socfpga_arria10_socdk_sdmmc.dtb socfpga_arria10_socdk_qspi.dtb"
```

## conf/machine/arria5.conf
```bitbake
#@TYPE: Machine
#@NAME: arria5
#@DESCRIPTION: Machine configuration for the Cyclone V SoC" 

require conf/machine/include/socfpga.inc

PREFERRED_VERSION_u-boot-socfpga = "2013.01.01"

UBOOT_MACHINE = "socfpga_arria5"

KMACHINE = "arria5"

if [ "${KERNEL_PROVIDER}" == "linux-altera" ] ; then
  KERNEL_DEVICETREE ?= "socfpga_arria5_socdk.dtb"
else
  KERNEL_DEVICETREE ?= "socfpga_arria5.dtb"
fi
```
